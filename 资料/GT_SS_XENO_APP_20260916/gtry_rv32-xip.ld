/* This file is generated by nds_ldsag (version (2026-01-27) ). */
/*Under commit SHA: 32c51a3bcfaea31b277118e7fdb9ae905fa4085d*/
ENTRY(_start)
SECTIONS
{
	/* FLASH (LOAD) */
	FLASH_LMA_ = ALIGN(0x80010000, 16);
	. = FLASH_LMA_;
	PROVIDE (__executable_start = .);

	/* EXEC (EXEC) */
	. = ALIGN(0x80010000, 16);
	EXEC .	: AT(FLASH_LMA_) {}
	EXEC_BEGIN = .;
	. = ALIGN(ALIGNOF(.init));
	.init 	: { KEEP(*(EXCLUDE_FILE (./src/tu_driver/* ./src/demo/keyboard.o ./src/driver/source/gtry_timer_drv.o ./src/bsp/gtry_trap.o ./src/demo/flash_driver/gtry6xx_flash_lib.o ./src/h6/*.o ).init )) }
	. = ALIGN(ALIGNOF(.text));
	.text 	: { *(EXCLUDE_FILE (./src/tu_driver/* ./src/demo/keyboard.o ./src/driver/source/gtry_timer_drv.o ./src/bsp/gtry_trap.o ./src/demo/flash_driver/gtry6xx_flash_lib.o ./src/h6/*.o ).text EXCLUDE_FILE (./src/tu_driver/* ./src/demo/keyboard.o ./src/driver/source/gtry_timer_drv.o ./src/bsp/gtry_trap.o ./src/demo/flash_driver/gtry6xx_flash_lib.o ./src/h6/*.o ).stub EXCLUDE_FILE (./src/tu_driver/* ./src/demo/keyboard.o ./src/driver/source/gtry_timer_drv.o ./src/bsp/gtry_trap.o ./src/demo/flash_driver/gtry6xx_flash_lib.o ./src/h6/*.o ).text.* EXCLUDE_FILE (./src/tu_driver/* ./src/demo/keyboard.o ./src/driver/source/gtry_timer_drv.o ./src/bsp/gtry_trap.o ./src/demo/flash_driver/gtry6xx_flash_lib.o ./src/h6/*.o ).gnu.linkonce.t.* ) KEEP(*(EXCLUDE_FILE (./src/tu_driver/* ./src/demo/keyboard.o ./src/driver/source/gtry_timer_drv.o ./src/bsp/gtry_trap.o ./src/demo/flash_driver/gtry6xx_flash_lib.o ./src/h6/*.o ).text.*personality* )) *(EXCLUDE_FILE (./src/tu_driver/* ./src/demo/keyboard.o ./src/driver/source/gtry_timer_drv.o ./src/bsp/gtry_trap.o ./src/demo/flash_driver/gtry6xx_flash_lib.o ./src/h6/*.o ).gnu.warning ) . = ALIGN(4); } = 0x0100
	. = ALIGN(ALIGNOF(.fini));
	.fini 	: { KEEP(*(EXCLUDE_FILE (./src/tu_driver/* ./src/demo/keyboard.o ./src/driver/source/gtry_timer_drv.o ./src/bsp/gtry_trap.o ./src/demo/flash_driver/gtry6xx_flash_lib.o ./src/h6/*.o ).fini )) }
	. = ALIGN(ALIGNOF(.riscv.jvt));
	.riscv.jvt 	: { *(EXCLUDE_FILE (./src/tu_driver/* ./src/demo/keyboard.o ./src/driver/source/gtry_timer_drv.o ./src/bsp/gtry_trap.o ./src/demo/flash_driver/gtry6xx_flash_lib.o ./src/h6/*.o ).riscv.jvt ) }
	. = ALIGN(ALIGNOF(.exec.itable));
	.exec.itable 	: { *(EXCLUDE_FILE (./src/tu_driver/* ./src/demo/keyboard.o ./src/driver/source/gtry_timer_drv.o ./src/bsp/gtry_trap.o ./src/demo/flash_driver/gtry6xx_flash_lib.o ./src/h6/*.o ).exec.itable ) }
	PROVIDE (__etext = .);
	PROVIDE (_etext = .);
	PROVIDE (etext = .);
	EXEC_SIZE = . - EXEC_BEGIN;

	/* DATA (LOAD) */
	DATA_LMA_ = ALIGN(LOADADDR(.exec.itable) + SIZEOF(.exec.itable) + 0, 8);
	. = DATA_LMA_;

	/* DLM (EXEC) */
	. = ALIGN(0x00200000, 16);
	DLM .	: AT(DATA_LMA_) {}
	DLM_BEGIN = .;

	/* RO */
	. = ALIGN(ALIGNOF(.interp));
	.interp .	: AT(ALIGN(LOADADDR(DLM), ALIGNOF(.interp)))	{ *(.interp ) }
	__data_lmastart =  LOADADDR(.interp);
	__data_start = ADDR(.interp);
	. = ALIGN(ALIGNOF(.note.gnu.build-id));
	.note.gnu.build-id 	: AT(ALIGN(LOADADDR(.interp) + SIZEOF(.interp), ALIGNOF(.note.gnu.build-id)))
		{ *(.note.gnu.build-id ) }
	. = ALIGN(ALIGNOF(.note.ABI-tag));
	.note.ABI-tag 	: AT(ALIGN(LOADADDR(.note.gnu.build-id) + SIZEOF(.note.gnu.build-id), ALIGNOF(.note.ABI-tag)))
		{ *(.note.ABI-tag ) }
	. = ALIGN(ALIGNOF(.hash));
	.hash 	: AT(ALIGN(LOADADDR(.note.ABI-tag) + SIZEOF(.note.ABI-tag), ALIGNOF(.hash)))
		{ *(.hash ) }
	. = ALIGN(ALIGNOF(.gnu.hash));
	.gnu.hash 	: AT(ALIGN(LOADADDR(.hash) + SIZEOF(.hash), ALIGNOF(.gnu.hash)))
		{ *(.gnu.hash ) }
	. = ALIGN(ALIGNOF(.dynsym));
	.dynsym 	: AT(ALIGN(LOADADDR(.gnu.hash) + SIZEOF(.gnu.hash), ALIGNOF(.dynsym)))
		{ *(.dynsym ) }
	. = ALIGN(ALIGNOF(.dynstr));
	.dynstr 	: AT(ALIGN(LOADADDR(.dynsym) + SIZEOF(.dynsym), ALIGNOF(.dynstr)))
		{ *(.dynstr ) }
	. = ALIGN(ALIGNOF(.gnu.version));
	.gnu.version 	: AT(ALIGN(LOADADDR(.dynstr) + SIZEOF(.dynstr), ALIGNOF(.gnu.version)))
		{ *(.gnu.version ) }
	. = ALIGN(ALIGNOF(.gnu.version_d));
	.gnu.version_d 	: AT(ALIGN(LOADADDR(.gnu.version) + SIZEOF(.gnu.version), ALIGNOF(.gnu.version_d)))
		{ *(.gnu.version_d ) }
	. = ALIGN(ALIGNOF(.gnu.version_r));
	.gnu.version_r 	: AT(ALIGN(LOADADDR(.gnu.version_d) + SIZEOF(.gnu.version_d), ALIGNOF(.gnu.version_r)))
		{ *(.gnu.version_r ) }
	. = ALIGN(ALIGNOF(.rela.init));
	.rela.init 	: AT(ALIGN(LOADADDR(.gnu.version_r) + SIZEOF(.gnu.version_r), ALIGNOF(.rela.init)))
		{ *(.rela.init ) }
	. = ALIGN(ALIGNOF(.rela.text));
	.rela.text 	: AT(ALIGN(LOADADDR(.rela.init) + SIZEOF(.rela.init), ALIGNOF(.rela.text)))
		{ *(.rela.text .rela.text.* .rela.gnu.linkonce.t.* ) }
	. = ALIGN(ALIGNOF(.rela.fini));
	.rela.fini 	: AT(ALIGN(LOADADDR(.rela.text) + SIZEOF(.rela.text), ALIGNOF(.rela.fini)))
		{ *(.rela.fini ) }
	. = ALIGN(ALIGNOF(.rela.rodata));
	.rela.rodata 	: AT(ALIGN(LOADADDR(.rela.fini) + SIZEOF(.rela.fini), ALIGNOF(.rela.rodata)))
		{ *(.rela.rodata .rela.rodata.* .rela.gnu.linkonce.r.* ) }
	. = ALIGN(ALIGNOF(.rela.data.rel.ro));
	.rela.data.rel.ro 	: AT(ALIGN(LOADADDR(.rela.rodata) + SIZEOF(.rela.rodata), ALIGNOF(.rela.data.rel.ro)))
		{ *(.rel.data.rel.ro* ) }
	. = ALIGN(ALIGNOF(.rela.data));
	.rela.data 	: AT(ALIGN(LOADADDR(.rela.data.rel.ro) + SIZEOF(.rela.data.rel.ro), ALIGNOF(.rela.data)))
		{ *(.rela.data .rela.data.* .rela.gnu.linkonce.d.* ) }
	. = ALIGN(ALIGNOF(.rela.tdata));
	.rela.tdata 	: AT(ALIGN(LOADADDR(.rela.data) + SIZEOF(.rela.data), ALIGNOF(.rela.tdata)))
		{ *(.rela.tdata .rela.tdata.* .rela.gnu.linkonce.td.* ) }
	. = ALIGN(ALIGNOF(.rela.tbss));
	.rela.tbss 	: AT(ALIGN(LOADADDR(.rela.tdata) + SIZEOF(.rela.tdata), ALIGNOF(.rela.tbss)))
		{ *(.rela.tbss .rela.tbss.* .rela.gnu.linkonce.tb.* ) }
	. = ALIGN(ALIGNOF(.rela.ctors));
	.rela.ctors 	: AT(ALIGN(LOADADDR(.rela.tbss) + SIZEOF(.rela.tbss), ALIGNOF(.rela.ctors)))
		{ *(.rela.ctors ) }
	. = ALIGN(ALIGNOF(.rela.dtors));
	.rela.dtors 	: AT(ALIGN(LOADADDR(.rela.ctors) + SIZEOF(.rela.ctors), ALIGNOF(.rela.dtors)))
		{ *(.rela.dtors ) }
	. = ALIGN(ALIGNOF(.rela.dyn));
	.rela.dyn 	: AT(ALIGN(LOADADDR(.rela.dtors) + SIZEOF(.rela.dtors), ALIGNOF(.rela.dyn)))
		{ *(rela.dyn ) *(.rela__libc_subfreeres ) *(.rela__libc_atexit ) *(.rela__libc_thread_subfreeres ) *(.rela.init_array ) *(.rela.fini_array ) }
	. = ALIGN(ALIGNOF(.rela.got));
	.rela.got 	: AT(ALIGN(LOADADDR(.rela.dyn) + SIZEOF(.rela.dyn), ALIGNOF(.rela.got)))
		{ *(.rela.got ) }
	. = ALIGN(ALIGNOF(.rela.sdata));
	.rela.sdata 	: AT(ALIGN(LOADADDR(.rela.got) + SIZEOF(.rela.got), ALIGNOF(.rela.sdata)))
		{ *(.rela.sdata .rela.sdata.* .rela.gnu.linkonce.s.* ) }
	. = ALIGN(ALIGNOF(.rela.sbss));
	.rela.sbss 	: AT(ALIGN(LOADADDR(.rela.sdata) + SIZEOF(.rela.sdata), ALIGNOF(.rela.sbss)))
		{ *(.rela.sbss .rela.sbss.* .rela.gnu.linkonce.sb.* ) }
	. = ALIGN(ALIGNOF(.rela.sdata2));
	.rela.sdata2 	: AT(ALIGN(LOADADDR(.rela.sbss) + SIZEOF(.rela.sbss), ALIGNOF(.rela.sdata2)))
		{ *(.rela.sdata2 .rela.sdata2.* .rela.gnu.linkonce.s2.* ) }
	. = ALIGN(ALIGNOF(.rela.sbss2));
	.rela.sbss2 	: AT(ALIGN(LOADADDR(.rela.sdata2) + SIZEOF(.rela.sdata2), ALIGNOF(.rela.sbss2)))
		{ *(.rela.sbss2 .rela.sbss2.* .rela.gnu.linkonce.sb2.* ) }
	. = ALIGN(ALIGNOF(.rela.bss));
	.rela.bss 	: AT(ALIGN(LOADADDR(.rela.sbss2) + SIZEOF(.rela.sbss2), ALIGNOF(.rela.bss)))
		{ *(.rela.bss .rela.bss.* .rela.gnu.linkonce.b.* ) }
	. = ALIGN(ALIGNOF(.rela.plt));
	.rela.plt 	: AT(ALIGN(LOADADDR(.rela.bss) + SIZEOF(.rela.bss), ALIGNOF(.rela.plt)))
		{ *(.rela.plt ) }
	. = ALIGN(ALIGNOF(.rodata));
	.rodata 	: AT(ALIGN(LOADADDR(.rela.plt) + SIZEOF(.rela.plt), ALIGNOF(.rodata)))
		{ *(.rodata .rodata.* .gnu.linkonce.r.* ) }
	. = ALIGN(ALIGNOF(.rodata1));
	.rodata1 	: AT(ALIGN(LOADADDR(.rodata) + SIZEOF(.rodata), ALIGNOF(.rodata1)))
		{ *(.rodata1 ) }
	. = ALIGN(ALIGNOF(.sdata2));
	.sdata2 	: AT(ALIGN(LOADADDR(.rodata1) + SIZEOF(.rodata1), ALIGNOF(.sdata2)))
		{ *(.sdata2 .sdata2.* .gnu.linkonce.s2.* ) }
	. = ALIGN(ALIGNOF(.sbss2));
	.sbss2 	: AT(ALIGN(LOADADDR(.sdata2) + SIZEOF(.sdata2), ALIGNOF(.sbss2)))
		{ *(.sbss2 .sbss2.* .gnu.linkonce.sb2.* ) }
	. = ALIGN(ALIGNOF(.eh_frame_hdr));
	.eh_frame_hdr 	: AT(ALIGN(LOADADDR(.sbss2) + SIZEOF(.sbss2), ALIGNOF(.eh_frame_hdr)))
		{ *(.eh_frame_hdr ) }

	/* RW */
	. = ALIGN(ALIGNOF(.eh_frame));
	.eh_frame 	: AT(ALIGN(LOADADDR(.eh_frame_hdr) + SIZEOF(.eh_frame_hdr), ALIGNOF(.eh_frame)))
		{ KEEP(*(.eh_frame )) }
	. = ALIGN(ALIGNOF(.gcc_except_table));
	.gcc_except_table 	: AT(ALIGN(LOADADDR(.eh_frame) + SIZEOF(.eh_frame), ALIGNOF(.gcc_except_table)))
		{ KEEP(*(.gcc_except_table )) *(.gcc_except_table.* ) }
	. = ALIGN(ALIGNOF(.tdata));
	.tdata 	: AT(ALIGN(LOADADDR(.gcc_except_table) + SIZEOF(.gcc_except_table), ALIGNOF(.tdata)))
		{ *(.tdata .tdata.* .gnu.linkonce.td.* ) }
	. = ALIGN(8);
	. = ALIGN(ALIGNOF(.preinit_array));
	.preinit_array 	: AT(ALIGN(ALIGN(LOADADDR(.tdata) + SIZEOF(.tdata), ALIGNOF(.preinit_array)), 8))
		{; PROVIDE (__preinit_array_start = .); KEEP(*(.preinit_array )); PROVIDE (__preinit_array_end = .); }
	. = ALIGN(ALIGNOF(.init_array));
	.init_array 	: AT(ALIGN(LOADADDR(.preinit_array) + SIZEOF(.preinit_array), ALIGNOF(.init_array)))
		{; PROVIDE (__init_array_start = .); KEEP(*(SORT_BY_INIT_PRIORITY(.init_array.* ))) KEEP(*(.init_array )); PROVIDE (__init_array_end = .); }
	. = ALIGN(ALIGNOF(.fini_array));
	.fini_array 	: AT(ALIGN(LOADADDR(.init_array) + SIZEOF(.init_array), ALIGNOF(.fini_array)))
		{; PROVIDE (__fini_array_start = .); KEEP(*(SORT_BY_INIT_PRIORITY(.fini_array.* ))) KEEP(*(.fini_array )); PROVIDE (__fini_array_end = .); }
	. = ALIGN(ALIGNOF(.tm_clone_table));
	.tm_clone_table 	: AT(ALIGN(LOADADDR(.fini_array) + SIZEOF(.fini_array), ALIGNOF(.tm_clone_table)))
		{ *(.tm_clone_table ) }
	. = ALIGN(ALIGNOF(.ctors));
	.ctors 	: AT(ALIGN(LOADADDR(.tm_clone_table) + SIZEOF(.tm_clone_table), ALIGNOF(.ctors)))
		{ KEEP(*crtbegin*.o(.ctors)) KEEP(*(EXCLUDE_FILE (*crtend*.o) .ctors)) KEEP(*(SORT(.ctors.* ))) KEEP(*(.ctors )) }
	. = ALIGN(ALIGNOF(.dtors));
	.dtors 	: AT(ALIGN(LOADADDR(.ctors) + SIZEOF(.ctors), ALIGNOF(.dtors)))
		{ KEEP(*crtbegin*.o(.dtors)) KEEP(*(EXCLUDE_FILE (*crtend*.o) .dtors)) KEEP(*(SORT(.dtors.* ))) KEEP(*(.dtors )) }
	. = ALIGN(ALIGNOF(.jcr));
	.jcr 	: AT(ALIGN(LOADADDR(.dtors) + SIZEOF(.dtors), ALIGNOF(.jcr)))
		{ KEEP(*(.jcr )) }
	. = ALIGN(ALIGNOF(.data.rel.ro));
	.data.rel.ro 	: AT(ALIGN(LOADADDR(.jcr) + SIZEOF(.jcr), ALIGNOF(.data.rel.ro)))
		{ *(.data.rel.ro.local ) *(.data.rel.ro* ) }
	. = ALIGN(ALIGNOF(.dynamic));
	.dynamic 	: AT(ALIGN(LOADADDR(.data.rel.ro) + SIZEOF(.data.rel.ro), ALIGNOF(.dynamic)))
		{ *(.dynamic ) }
	. = ALIGN(8);
	. = ALIGN(ALIGNOF(.got));
	.got 	: AT(ALIGN(ALIGN(LOADADDR(.dynamic) + SIZEOF(.dynamic), ALIGNOF(.got)), 8))
		{ *(.got.plt ) *(.got ) }
	. = ALIGN(ALIGNOF(.data));
	.data 	: AT(ALIGN(LOADADDR(.got) + SIZEOF(.got), ALIGNOF(.data)))
		{ *(.data .data.* .gnu.linkonce.d.* ) KEEP(*(.gnu.linkonce.d.*personality* )) SORT(CONSTRUCTORS) . = ALIGN(8); }
	. = ALIGN(ALIGNOF(.data1));
	.data1 	: AT(ALIGN(LOADADDR(.data) + SIZEOF(.data), ALIGNOF(.data1)))
		{ *(.data1 ) . = ALIGN(8); }
	. = ALIGN(8);
	. = ALIGN(ALIGNOF(.sdata));
	.sdata 	: AT(ALIGN(ALIGN(LOADADDR(.data1) + SIZEOF(.data1), ALIGNOF(.sdata)), 8))
		{ *(.srodata.cst16 ) *(.srodata.cst8 ) *(.srodata.cst4 ) *(.srodata.cst2 ) *(.srodata .srodata.* ) *(.sdata .sdata.* .gnu.linkonce.s.* ) }
	. = ALIGN(ALIGNOF(.sdata_d));
	.sdata_d 	: AT(ALIGN(LOADADDR(.sdata) + SIZEOF(.sdata), ALIGNOF(.sdata_d)))
		{ *(.sdata_d .sdata_d.* ) }
	. = ALIGN(ALIGNOF(.sdata_w));
	.sdata_w 	: AT(ALIGN(LOADADDR(.sdata_d) + SIZEOF(.sdata_d), ALIGNOF(.sdata_w)))
		{ *(.sdata_w .sdata_w.* ) }
	. = ALIGN(ALIGNOF(.sdata_h));
	.sdata_h 	: AT(ALIGN(LOADADDR(.sdata_w) + SIZEOF(.sdata_w), ALIGNOF(.sdata_h)))
		{ *(.sdata_h .sdata_h.* ) }
	. = ALIGN(ALIGNOF(.sdata_b));
	.sdata_b 	: AT(ALIGN(LOADADDR(.sdata_h) + SIZEOF(.sdata_h), ALIGNOF(.sdata_b)))
		{ *(.sdata_b .sdata_b.* ) }
	. = ALIGN(ALIGNOF(.sdata_f));
	.sdata_f 	: AT(ALIGN(LOADADDR(.sdata_b) + SIZEOF(.sdata_b), ALIGNOF(.sdata_f)))
		{ *(.sdata_f .sdata_f.* ) }
	. = ALIGN(8);
	_edata = .;
	PROVIDE (edata = .);

	/* ZI */
	. = ALIGN(ALIGNOF (.tbss));
	__bss_start = .;
	PROVIDE (__sbss_start = .);
	PROVIDE (___sbss_start = .);
	.tbss 	(NOLOAD)	: { *(.tbss .tbss.* .gnu.linkonce.tb.* ) *(.tcommon ) }
	.sbss 	(NOLOAD)	: { *(.dynsbss ) *(.sbss .sbss.* .gnu.linkonce.sb.* ) *(.scommon .scommon.* ) }
	.sbss_f 	(NOLOAD)	: { *(.sbss_f .sbss_f.* ) *(.scommon_f .scommon_f.* ) }
	.sbss_b 	(NOLOAD)	: { *(.sbss_b .sbss_b.* ) *(.scommon_b .scommon_b.* ) . = ALIGN(2); }
	.sbss_h 	(NOLOAD)	: { *(.sbss_h .sbss_h.* ) *(.scommon_h .scommon_h.* ) . = ALIGN(4); }
	.sbss_w 	(NOLOAD)	: { *(.sbss_w .sbss_w.* ) *(.scommon_w .scommon_w.* ) *(.dynsbss ) *(.scommon ) . = ALIGN(8); }
	.sbss_d 	(NOLOAD)	: { *(.sbss_d .sbss_d.* ) *(.scommon_d .scommon_d.* ) }
	.bss 	(NOLOAD)	: { *(.dynbss ) *(.bss .bss.* .gnu.linkonce.b.* ) *(COMMON ) . = ALIGN(8); }
	PROVIDE (__sbss_end = .);
	PROVIDE (___sbss_end = .);
	. = ALIGN(8);
	_end = .;
	PROVIDE (end = .);
	DLM_SIZE = . - DLM_BEGIN;

	/* RAM (LOAD) */
	RAM_LMA_ = ALIGN(LOADADDR(.sdata_f) + SIZEOF(.sdata_f) + 0, 8);
	. = RAM_LMA_;

	/* ILM (EXEC) */
	. = ALIGN(0x0, 16);
	ILM .	: AT(RAM_LMA_) {}
	ILM_BEGIN = .;

	/* ISR */
	. = ALIGN(ALIGNOF(.nds_vector));
	.nds_vector .	: AT(ALIGN(ALIGN(LOADADDR(ILM), ALIGNOF(.nds_vector)), 8))	{ KEEP(*(.nds_vector )) KEEP(*(SORT(.nds_vector.* ))) }
	__ramrun_lmastart =  LOADADDR(.nds_vector);
	__ramrun_start = ADDR(.nds_vector);

	/* .ram_ilm */
	. = ALIGN(ALIGNOF(.ram_ilm));
	.ram_ilm 	: AT(ALIGN(LOADADDR(.nds_vector) + SIZEOF(.nds_vector), ALIGNOF(.ram_ilm)))
		{ *(.ram_ilm ) }

	/* .ilm_data */
	. = ALIGN(ALIGNOF(.ilm_data));
	.ilm_data 	: AT(ALIGN(LOADADDR(.ram_ilm) + SIZEOF(.ram_ilm), ALIGNOF(.ilm_data)))
		{ *(.ilm_data ) }

	/* .flash_ep_ilm */
	. = ALIGN(ALIGNOF(.flash_ep_ilm));
	.flash_ep_ilm 	: AT(ALIGN(LOADADDR(.ilm_data) + SIZEOF(.ilm_data), ALIGNOF(.flash_ep_ilm)))
		{ *(.flash_ep_ilm ) }

	/* RO */
	. = ALIGN(ALIGNOF(".init_.driverstu_driver*"));
	".init_.driverstu_driver*" 	: AT(ALIGN(LOADADDR(.flash_ep_ilm) + SIZEOF(.flash_ep_ilm), ALIGNOF(".init_.driverstu_driver*")))
		{ KEEP(./src/tu_driver/*(.init )) }
	. = ALIGN(ALIGNOF(".text_.driverstu_driver*"));
	".text_.driverstu_driver*" 	: AT(ALIGN(LOADADDR(".init_.driverstu_driver*") + SIZEOF(".init_.driverstu_driver*"), ALIGNOF(".text_.driverstu_driver*")))
		{ ./src/tu_driver/*(.text .stub .text.* .gnu.linkonce.t.* ) KEEP(./src/tu_driver/*(.text.*personality* )) ./src/tu_driver/*(.gnu.warning ) . = ALIGN(4); } = 0x0100
	. = ALIGN(ALIGNOF(".fini_.driverstu_driver*"));
	".fini_.driverstu_driver*" 	: AT(ALIGN(LOADADDR(".text_.driverstu_driver*") + SIZEOF(".text_.driverstu_driver*"), ALIGNOF(".fini_.driverstu_driver*")))
		{ KEEP(./src/tu_driver/*(.fini )) }
	. = ALIGN(ALIGNOF(".riscv.jvt_.driverstu_driver*"));
	".riscv.jvt_.driverstu_driver*" 	: AT(ALIGN(LOADADDR(".fini_.driverstu_driver*") + SIZEOF(".fini_.driverstu_driver*"), ALIGNOF(".riscv.jvt_.driverstu_driver*")))
		{ ./src/tu_driver/*(.riscv.jvt ) }
	. = ALIGN(ALIGNOF(".exec.itable_.driverstu_driver*"));
	".exec.itable_.driverstu_driver*" 	: AT(ALIGN(LOADADDR(".riscv.jvt_.driverstu_driver*") + SIZEOF(".riscv.jvt_.driverstu_driver*"), ALIGNOF(".exec.itable_.driverstu_driver*")))
		{ ./src/tu_driver/*(.exec.itable ) }
	PROVIDE (__etext = .);
	PROVIDE (_etext = .);
	PROVIDE (etext = .);

	/* RO */
	. = ALIGN(ALIGNOF(.init_.srcdemokeyboard.o));
	.init_.srcdemokeyboard.o 	: AT(ALIGN(LOADADDR(".exec.itable_.driverstu_driver*") + SIZEOF(".exec.itable_.driverstu_driver*"), ALIGNOF(.init_.srcdemokeyboard.o)))
		{ KEEP(./src/demo/keyboard.o(.init )) }
	. = ALIGN(ALIGNOF(.text_.srcdemokeyboard.o));
	.text_.srcdemokeyboard.o 	: AT(ALIGN(LOADADDR(.init_.srcdemokeyboard.o) + SIZEOF(.init_.srcdemokeyboard.o), ALIGNOF(.text_.srcdemokeyboard.o)))
		{ ./src/demo/keyboard.o(.text .stub .text.* .gnu.linkonce.t.* ) KEEP(./src/demo/keyboard.o(.text.*personality* )) ./src/demo/keyboard.o(.gnu.warning ) . = ALIGN(4); } = 0x0100
	. = ALIGN(ALIGNOF(.fini_.srcdemokeyboard.o));
	.fini_.srcdemokeyboard.o 	: AT(ALIGN(LOADADDR(.text_.srcdemokeyboard.o) + SIZEOF(.text_.srcdemokeyboard.o), ALIGNOF(.fini_.srcdemokeyboard.o)))
		{ KEEP(./src/demo/keyboard.o(.fini )) }
	. = ALIGN(ALIGNOF(.riscv.jvt_.srcdemokeyboard.o));
	.riscv.jvt_.srcdemokeyboard.o 	: AT(ALIGN(LOADADDR(.fini_.srcdemokeyboard.o) + SIZEOF(.fini_.srcdemokeyboard.o), ALIGNOF(.riscv.jvt_.srcdemokeyboard.o)))
		{ ./src/demo/keyboard.o(.riscv.jvt ) }
	. = ALIGN(ALIGNOF(.exec.itable_.srcdemokeyboard.o));
	.exec.itable_.srcdemokeyboard.o 	: AT(ALIGN(LOADADDR(.riscv.jvt_.srcdemokeyboard.o) + SIZEOF(.riscv.jvt_.srcdemokeyboard.o), ALIGNOF(.exec.itable_.srcdemokeyboard.o)))
		{ ./src/demo/keyboard.o(.exec.itable ) }
	PROVIDE (__etext = .);
	PROVIDE (_etext = .);
	PROVIDE (etext = .);

	/* RO */
	. = ALIGN(ALIGNOF(.init_.driversdriversourcegtry_timer_drv.o));
	.init_.driversdriversourcegtry_timer_drv.o 	: AT(ALIGN(LOADADDR(.exec.itable_.srcdemokeyboard.o) + SIZEOF(.exec.itable_.srcdemokeyboard.o), ALIGNOF(.init_.driversdriversourcegtry_timer_drv.o)))
		{ KEEP(./src/driver/source/gtry_timer_drv.o(.init )) }
	. = ALIGN(ALIGNOF(.text_.driversdriversourcegtry_timer_drv.o));
	.text_.driversdriversourcegtry_timer_drv.o 	: AT(ALIGN(LOADADDR(.init_.driversdriversourcegtry_timer_drv.o) + SIZEOF(.init_.driversdriversourcegtry_timer_drv.o), ALIGNOF(.text_.driversdriversourcegtry_timer_drv.o)))
		{ ./src/driver/source/gtry_timer_drv.o(.text .stub .text.* .gnu.linkonce.t.* ) KEEP(./src/driver/source/gtry_timer_drv.o(.text.*personality* )) ./src/driver/source/gtry_timer_drv.o(.gnu.warning ) . = ALIGN(4); } = 0x0100
	. = ALIGN(ALIGNOF(.fini_.driversdriversourcegtry_timer_drv.o));
	.fini_.driversdriversourcegtry_timer_drv.o 	: AT(ALIGN(LOADADDR(.text_.driversdriversourcegtry_timer_drv.o) + SIZEOF(.text_.driversdriversourcegtry_timer_drv.o), ALIGNOF(.fini_.driversdriversourcegtry_timer_drv.o)))
		{ KEEP(./src/driver/source/gtry_timer_drv.o(.fini )) }
	. = ALIGN(ALIGNOF(.riscv.jvt_.driversdriversourcegtry_timer_drv.o));
	.riscv.jvt_.driversdriversourcegtry_timer_drv.o 	: AT(ALIGN(LOADADDR(.fini_.driversdriversourcegtry_timer_drv.o) + SIZEOF(.fini_.driversdriversourcegtry_timer_drv.o), ALIGNOF(.riscv.jvt_.driversdriversourcegtry_timer_drv.o)))
		{ ./src/driver/source/gtry_timer_drv.o(.riscv.jvt ) }
	. = ALIGN(ALIGNOF(.exec.itable_.driversdriversourcegtry_timer_drv.o));
	.exec.itable_.driversdriversourcegtry_timer_drv.o 	: AT(ALIGN(LOADADDR(.riscv.jvt_.driversdriversourcegtry_timer_drv.o) + SIZEOF(.riscv.jvt_.driversdriversourcegtry_timer_drv.o), ALIGNOF(.exec.itable_.driversdriversourcegtry_timer_drv.o)))
		{ ./src/driver/source/gtry_timer_drv.o(.exec.itable ) }
	PROVIDE (__etext = .);
	PROVIDE (_etext = .);
	PROVIDE (etext = .);

	/* RO */
	. = ALIGN(ALIGNOF(.init_.srcbspgtry_trap.o));
	.init_.srcbspgtry_trap.o 	: AT(ALIGN(LOADADDR(.exec.itable_.driversdriversourcegtry_timer_drv.o) + SIZEOF(.exec.itable_.driversdriversourcegtry_timer_drv.o), ALIGNOF(.init_.srcbspgtry_trap.o)))
		{ KEEP(./src/bsp/gtry_trap.o(.init )) }
	. = ALIGN(ALIGNOF(.text_.srcbspgtry_trap.o));
	.text_.srcbspgtry_trap.o 	: AT(ALIGN(LOADADDR(.init_.srcbspgtry_trap.o) + SIZEOF(.init_.srcbspgtry_trap.o), ALIGNOF(.text_.srcbspgtry_trap.o)))
		{ ./src/bsp/gtry_trap.o(.text .stub .text.* .gnu.linkonce.t.* ) KEEP(./src/bsp/gtry_trap.o(.text.*personality* )) ./src/bsp/gtry_trap.o(.gnu.warning ) . = ALIGN(4); } = 0x0100
	. = ALIGN(ALIGNOF(.fini_.srcbspgtry_trap.o));
	.fini_.srcbspgtry_trap.o 	: AT(ALIGN(LOADADDR(.text_.srcbspgtry_trap.o) + SIZEOF(.text_.srcbspgtry_trap.o), ALIGNOF(.fini_.srcbspgtry_trap.o)))
		{ KEEP(./src/bsp/gtry_trap.o(.fini )) }
	. = ALIGN(ALIGNOF(.riscv.jvt_.srcbspgtry_trap.o));
	.riscv.jvt_.srcbspgtry_trap.o 	: AT(ALIGN(LOADADDR(.fini_.srcbspgtry_trap.o) + SIZEOF(.fini_.srcbspgtry_trap.o), ALIGNOF(.riscv.jvt_.srcbspgtry_trap.o)))
		{ ./src/bsp/gtry_trap.o(.riscv.jvt ) }
	. = ALIGN(ALIGNOF(.exec.itable_.srcbspgtry_trap.o));
	.exec.itable_.srcbspgtry_trap.o 	: AT(ALIGN(LOADADDR(.riscv.jvt_.srcbspgtry_trap.o) + SIZEOF(.riscv.jvt_.srcbspgtry_trap.o), ALIGNOF(.exec.itable_.srcbspgtry_trap.o)))
		{ ./src/bsp/gtry_trap.o(.exec.itable ) }
	PROVIDE (__etext = .);
	PROVIDE (_etext = .);
	PROVIDE (etext = .);


	/* RO */
	. = ALIGN(ALIGNOF(".init_.srch6*.o"));
	".init_.srch6*.o" 	: AT(ALIGN(LOADADDR(.exec.itable_.srcbspgtry_trap.o) + SIZEOF(.exec.itable_.srcbspgtry_trap.o), ALIGNOF(".init_.srch6*.o")))
		{ KEEP(./src/h6/*.o(.init )) }
	. = ALIGN(ALIGNOF(".text_.srch6*.o"));
	".text_.srch6*.o" 	: AT(ALIGN(LOADADDR(".init_.srch6*.o") + SIZEOF(".init_.srch6*.o"), ALIGNOF(".text_.srch6*.o")))
		{ ./src/h6/*.o(.text .stub .text.* .gnu.linkonce.t.* ) KEEP(./src/h6/*.o(.text.*personality* )) ./src/h6/*.o(.gnu.warning ) . = ALIGN(4); } = 0x0100
	. = ALIGN(ALIGNOF(".fini_.srch6*.o"));
	".fini_.srch6*.o" 	: AT(ALIGN(LOADADDR(".text_.srch6*.o") + SIZEOF(".text_.srch6*.o"), ALIGNOF(".fini_.srch6*.o")))
		{ KEEP(./src/h6/*.o(.fini )) }
	. = ALIGN(ALIGNOF(".riscv.jvt_.srch6*.o"));
	".riscv.jvt_.srch6*.o" 	: AT(ALIGN(LOADADDR(".fini_.srch6*.o") + SIZEOF(".fini_.srch6*.o"), ALIGNOF(".riscv.jvt_.srch6*.o")))
		{ ./src/h6/*.o(.riscv.jvt ) }
	. = ALIGN(ALIGNOF(".exec.itable_.srch6*.o"));
	".exec.itable_.srch6*.o" 	: AT(ALIGN(LOADADDR(".riscv.jvt_.srch6*.o") + SIZEOF(".riscv.jvt_.srch6*.o"), ALIGNOF(".exec.itable_.srch6*.o")))
		{ ./src/h6/*.o(.exec.itable ) }
	PROVIDE (__etext = .);
	PROVIDE (_etext = .);
	PROVIDE (etext = .);
	__ramrun_lmaend =  LOADADDR(".exec.itable_.srch6*.o") + SIZEOF(".exec.itable_.srch6*.o");
	PROVIDE (_stack = 0x00030000);
	ILM_SIZE = . - ILM_BEGIN;

	/* SRAM0 (LOAD) */
	SRAM0_LMA_ = ALIGN(LOADADDR(".exec.itable_.srch6*.o") + SIZEOF(".exec.itable_.srch6*.o") + 0, 8);
	. = SRAM0_LMA_;

	/* SEC0 (EXEC) */
	. = ALIGN(0x00210000, 16);
	SEC0 .	: AT(SRAM0_LMA_) {}
	SEC0_BEGIN = .;

	/* .section_sram */
	. = ALIGN(ALIGNOF(.section_sram));
	.section_sram 	: AT(ALIGN(LOADADDR(SEC0), ALIGNOF(.section_sram)))
		{ *(.section_sram ) }
	__sram_lmastart =  LOADADDR(.section_sram);
	__sram_start = ADDR(.section_sram);
	__sram_lmaend =  LOADADDR(.section_sram) + SIZEOF(.section_sram);
	SEC0_SIZE = . - SEC0_BEGIN;

	.stab	0 : { *(.stab) }
	.stabstr	0 : { *(.stabstr) }
	.stab.excl	0 : { *(.stab.excl) }
	.stab.exclstr	0 : { *(.stab.exclstr) }
	.stab.index	0 : { *(.stab.index) }
	.stab.indexstr	0 : { *(.stab.indexstr) }
	.comment	0 : { *(.comment) }
	.debug	0 : { *(.debug) }
	.line	0 : { *(.line) }
	.debug_srcinfo	0 : { *(.debug_srcinfo) }
	.debug_sfnames	0 : { *(.debug_sfnames) }
	.debug_aranges	0 : { *(.debug_aranges) }
	.debug_pubnames	0 : { *(.debug_pubnames) }
	.debug_info	0 : { *(.debug_info .gnu.linkonce.wi.*) }
	.debug_abbrev	0 : { *(.debug_abbrev) }
	.debug_line	0 : { *(.debug_line) }
	.debug_frame	0 : { *(.debug_frame) }
	.debug_str	0 : { *(.debug_str) }
	.debug_loc	0 : { *(.debug_loc) }
	.debug_macinfo	0 : { *(.debug_macinfo) }
	.debug_weaknames	0 : { *(.debug_weaknames) }
	.debug_funcnames	0 : { *(.debug_funcnames) }
	.debug_typenames	0 : { *(.debug_typenames) }
	.debug_varnames	0 : { *(.debug_varnames) }
	.debug_pubtypes	0 : { *(.debug_pubtypes) }
	.debug_ranges	0 : { *(.debug_ranges) }
	.debug_addr	0 : { *(.debug_addr) }
	.debug_line_str	0 : { *(.debug_line_str) }
	.debug_loclists	0 : { *(.debug_loclists) }
	.debug_names	0 : { *(.debug_names) }
	.debug_rnglists	0 : { *(.debug_rnglists) }
	.debug_str_offsets	0 : { *(.debug_str_offsets) }
	.debug_sup	0 : { *(.debug_sup) }
}
ASSERT( EXEC_SIZE <= 0x00078000, "EXEC OVERFLOW");
ASSERT( DLM_SIZE <= 0x00010000, "DLM OVERFLOW");
ASSERT( ILM_SIZE <= 0x00030000, "ILM OVERFLOW");
ASSERT( SEC0_SIZE <= 0x8000, "SEC0 OVERFLOW");
